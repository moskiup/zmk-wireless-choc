## config/west.yml
```yaml
manifest:
  remotes:
    - name: zmkfirmware
      url-base: https://github.com/zmkfirmware
  projects:
    - name: zmk
      remote: zmkfirmware
      revision: main
      import: app/west.yml
    - name: nv-gem
      url: https://github.com/MechboardsLTD/zmk-module
      revision: nv_gem
  self:
    path: config
```
